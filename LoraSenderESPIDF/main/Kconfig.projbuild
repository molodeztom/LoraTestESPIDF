## LoraSenderESPIDF/main/Kconfig.projbuild
```kconfig
menu "LORA Debug Settings"
config DEBUG_LORA
        bool "activate  LORA Debug Mode"
        default n
        help
          This option enables the LORA debug mode. It is used to print out the LORA debug information.
          If you want to use the LORA debug mode, please set this option to y.
          If you don't want to use the LORA debug mode, please set this option to n.
          The default value is n.
          
endmenu
```
